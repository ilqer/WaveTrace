## firmware/esp32_node/sdkconfig.defaults
```kconfig
# Required for CSI capture — off by default in ESP-IDF menuconfig.
CONFIG_ESP_WIFI_CSI_ENABLED=y
# 1000 Hz tick so the burst spacing (vTaskDelay) can reach 1 ms -> 100 Hz+ per-link CSI.
# Default 100 Hz capped us at ~10 ms spacing. (ESP32-CSI-Tool mandates this too.)
CONFIG_FREERTOS_HZ=1000

# --- Mesh CSI stability (added 2026-06-18) ---
# AMPDU aggregation is useless for per-packet CSI and triggers the AP's relentless
# ADDBA/DELBA(reason 39) teardown churn that stalls the link. CSI tools disable it.
CONFIG_ESP_WIFI_AMPDU_RX_ENABLED=n
CONFIG_ESP_WIFI_AMPDU_TX_ENABLED=n
# More RX headroom: the all-pairs promiscuous capture floods the RX path; thin buffers (10/32)
# let the sniffer hit a recycled/exhausted buffer -> LoadProhibited / interrupt-WDT reset.
CONFIG_ESP_WIFI_STATIC_RX_BUFFER_NUM=16
CONFIG_ESP_WIFI_DYNAMIC_RX_BUFFER_NUM=64
# Keep the radio fully awake even while disconnected -> faster reconnect, steadier RX (ESPectre).
CONFIG_ESP_WIFI_STA_DISCONNECTED_PM_ENABLE=n

# --- UDP uplink headroom (added 2026-06-19; TX buffers made static 2026-06-23) ---
# The CSI uplink is bursty (~400 fps batched). DYNAMIC TX buffers are allocated from the same heap the
# 99 KB CSI queue + RX buffers squeeze, so they vanish exactly under the congestion that needs them ->
# `sendto` ENOMEM (errno 12). STATIC TX buffers are pre-allocated at boot (~1.6 KB each), so a burst
# always has guaranteed, heap-immune TX slots. Paired with the queue halved to 128 (frees ~50 KB), so
# carving these out doesn't starve general heap. AMPDU-TX is off above, so static TX is unconstrained.
# 16 ≈ 26 KB pre-allocated; raise if the health-log free heap stays comfortable on hardware.
CONFIG_ESP_WIFI_TX_BUFFER_TYPE=0
CONFIG_ESP_WIFI_STATIC_TX_BUFFER_NUM=16
# Bigger tcpip mailbox + lwIP heap so queued UDP pbufs don't starve the stack during a burst.
CONFIG_LWIP_TCPIP_RECVMBOX_SIZE=64
CONFIG_LWIP_UDP_RECVMBOX_SIZE=16
```

## firmware/esp32_rx/sdkconfig.defaults
```kconfig
# WaveTrace RX defaults. Apply target with: idf.py set-target esp32s3
CONFIG_ESP_WIFI_CSI_ENABLED=y
CONFIG_ESPTOOLPY_FLASHSIZE_4MB=y
CONFIG_ESP_MAIN_TASK_STACK_SIZE=8192
CONFIG_FREERTOS_HZ=1000
# High console baud so 100 CSI CSV lines/sec don't overflow UART -> matches SerialReader(baud=921600)
CONFIG_ESP_CONSOLE_UART_BAUDRATE=921600
```

## firmware/esp32_tx/sdkconfig.defaults
```kconfig
# WaveTrace TX defaults. Apply target with: idf.py set-target esp32s3
CONFIG_ESPTOOLPY_FLASHSIZE_4MB=y
CONFIG_ESP_MAIN_TASK_STACK_SIZE=8192
CONFIG_FREERTOS_HZ=1000
```
